## sdkconfig.defaults
```kconfig
CONFIG_IDF_TARGET="esp32c6"

CONFIG_ESP_WIFI_ENABLED=y
CONFIG_BT_NIMBLE_EXT_ADV=n

# UWB DW3000
# Decadriver
CONFIG_DW3000_GPIO_IRQ=5
CONFIG_DW3000_GPIO_RESET=14
CONFIG_DW3000_GPIO_WAKEUP=15
CONFIG_DW3000_SPI_MOSI=7
CONFIG_DW3000_SPI_MISO=4
CONFIG_DW3000_SPI_CLK=3
CONFIG_DW3000_SPI_CS=6
CONFIG_DW3000_CHIP_DW3000=y
```
